## Kconfig
```kconfig
# DT_COMPAT_ZMK_DRIVER_KSCAN_HE_DIRECT_PULSED := zmk,kscan-he-direct-pulsed
# DT_COMPAT_ZMK_DRIVER_KSCAN_FORWARDER := zmk,kscan-forwarder

# config HE_DRIVER_KSCAN_HE_DIRECT_PULSED
#     bool
#     default $(dt_compat_enabled,$(DT_COMPAT_ZMK_DRIVER_KSCAN_HE_DIRECT_PULSED))

# config HE_DRIVER_KSCAN_FORWARDER
#     bool
#     default $(dt_compat_enabled,$(DT_COMPAT_ZMK_DRIVER_KSCAN_FORWARDER))

config ZMK_BLE_GAMEPAD_REPORT_QUEUE_SIZE
    int "Max number of mouse HID reports to queue for sending over BLE"
    default 20

config HE_LOG_LEVEL
    int "Log level for HE driver"
    default ZMK_LOG_LEVEL

config HE_INPUT_LISTENER
    bool "Enable modified input listener"
    default y
    depends on DT_HAS_HE_INPUT_LISTENER_ENABLED
    select ZMK_POINTING

config HE_INPUT_SPLIT
    bool "Enable modified input split"
    default y
    depends on DT_HAS_HE_INPUT_SPLIT_ENABLED
    depends on ZMK_SPLIT
    depends on !ZMK_SPLIT_ROLE_CENTRAL
    select ZMK_POINTING

rsource "src/behaviors/Kconfig"
rsource "src/input_processors/Kconfig"
rsource "src/kscan/Kconfig"
rsource "src/sensor/Kconfig"
rsource "src/hid/Kconfig"
```

## dts/bindings/behaviors/he,behavior-gamepad-btn.yaml
```yaml
# Copyright (c) 2025, cr3eperall
# SPDX-License-Identifier: MIT

description: Send a gamepad button event

compatible: "he,behavior-gamepad-btn"

include: one_param.yaml
```

## dts/bindings/behaviors/he,behavior-pulse-set.yaml
```yaml
# Copyright (c) 2025, cr3eperall
# SPDX-License-Identifier: MIT

description: Set the pulse mode of kscan-he-direct-pulsed

compatible: "he,behavior-pulse-set"

include: one_param.yaml

# param1==0: disable pulse mode
# param1==1: enable pulse mode
# param1==2: toggle pulse mode
properties:
  pulse-set-forwarder:
    description: The pulse set forwarder to use for this behavior
    type: phandle
    required: true
```

## dts/bindings/behaviors/he,behavior-set-pulse.yaml
```yaml
# Copyright (c) 2025, cr3eperall
# SPDX-License-Identifier: MIT

description: Set the pulse mode of kscan-he-direct-pulsed

compatible: "he,behavior-set-pulse"

include: one_param.yaml

# param1==0: disable pulse mode
# param1==1: enable pulse mode
# param1==2: toggle pulse mode
properties:
  kscan-forwarder:
    description: The kscan forwarder to use for this behavior
    type: phandle
    required: true
```

## dts/bindings/behaviors/zmk,behavior-gamepad-btn.yaml
```yaml
# Copyright (c) 2025, cr3eperall
# SPDX-License-Identifier: MIT

description: Send a gamepad button event

compatible: "zmk,behavior-gamepad-btn"

include: one_param.yaml
```

## dts/bindings/he,input-listener.yaml
```yaml
# Copyright (c) 2024 The ZMK Contributors
# SPDX-License-Identifier: MIT

description: |
  Listener to subscribe to input events and send HID updates after processing 
  Extended to allow for stopping of layer processing on ZMK_INPUT_PROC_STOP

compatible: "he,input-listener"

properties:
  device:
    type: phandle
    required: true
  input-processors:
    type: phandle-array

child-binding:
  description: "Listener overrides for certain layers"

  properties:
    layers:
      type: array
      required: true
    process-next:
      type: boolean
    input-processors:
      type: phandle-array
```

## dts/bindings/he,input-split.yaml
```yaml
# Copyright (c) 2024 The ZMK Contributors
# SPDX-License-Identifier: MIT

include: [base.yaml]

compatible: "he,input-split"

description: Device to wire up an input device for split use, doesn't send inputs if an input processor returns ZMK_INPUT_PROC_STOP.

properties:
  reg:
    required: true

  device:
    type: phandle

  input-processors:
    type: phandle-array
```

## dts/bindings/he,kscan-forwarder.yaml
```yaml
# Copyright (c) 2025, cr3eperall
# SPDX-License-Identifier: MIT

description: Device that allows any device to generate kscan events by forwarding the event to a compatible driver.

compatible: "he,kscan-forwarder"
```

## dts/bindings/he,kscan-multiplexer.yaml
```yaml
# Copyright (c) 2025, cr3eperall
# SPDX-License-Identifier: MIT

description: Hall effect kscan controller that produces INPUT_HE_RC analog inputs in micrometers of height

compatible: "he,kscan-multiplexer"

include: kscan.yaml

properties:
  resolution:
    type: int
    default: 12
    enum:
      - 8
      - 10
      - 12
  address-gpios:
    description: address GPIOs ordered from LSB to MSB
    type: phandle-array
    required: true
  address-to-read-delay:
    description: Time to wait before reading the key after sending the address
    type: int
    default: 0
  wait-period-idle:
    description: Time between reads in milliseconds when no activity is detected
    type: int
    default: 5
  wait-period-press:
    description: Time between reads in milliseconds when activity is detected
    type: int
    default: 1
  kscan-forwarder:
    description: kscan-forwarder to pass the kscan callback to
    type: phandle
  calibrate:
    description: Print the raw values to serial and don't send them to the input listener
    type: boolean
  polyfit:
    description: Polynomial fit coefficients as an array of floats represented as 32-bit hex integers(first coefficient is the highest degree coefficient, last is the constant term)
    type: array
    default: #coefficients calculated for Gateron low profile magnetic jade pro
      - 0x408b2298
      - 0xc1167de4
      - 0x40fed831
      - 0xc02b2742
      - 0x3f404977
      - 0x3bd693e5
  default-calibration-min:
    description: Default minimum value to consider for calibration if not specified in the child binding
    type: int
    default: 0
  default-calibration-max:
    description: Default maximum value to consider for calibration if not specified in the child binding
    type: int
    default: 0
  default-deadzone-top:
    description: Default threshold to start producing events in micrometers from the top if not specified in the child binding
    type: int
    default: 250
  default-deadzone-bottom:
    description: Default threshold to pause producing events in micrometers from the bottom if not specified in the child binding
    type: int
    default: 250

child-binding:
  description: Per adc group configuration
  properties:
    io-channels:
      description: ADC channel for this group
      type: phandle-array
      required: true
    switch-pressed-is-higher:
      type: boolean
    address-range-min:
      description: Minimum address in this group(inclusive)
      type: int
      required: true
    address-range-max:
      description: Maximum address in this group(inclusive)
      type: int
      required: true
    switch-height:
      description: Height of the switch in micrometers
      type: int
      default: 3300
      
  child-binding:
    description: Per key configuration
    properties:
      deadzone-top:
        type: int
        description: Threshold to start producing events in micrometers from the top
        default: 250
      deadzone-bottom:
        type: int
        description: Threshold to pause producing events in micrometers from the bottom
        default: 250
      calibration-min:
        type: int
        description: Minimum value to consider for calibration
        default: 0
      calibration-max:
        type: int
        description: Maximum value to consider for calibration
        default: 0
        
```

## dts/bindings/he,pulse-set-forwarder.yaml
```yaml
# Copyright (c) 2025, cr3eperall
# SPDX-License-Identifier: MIT

description: Device that allows any device to change the pulse mode of a compatible driver.

compatible: "he,pulse-set-forwarder"
```

## dts/bindings/input_processors/he,input-processor-adjustable-actuation.yaml
```yaml
# Copyright (c) 2025, cr3eperall
# SPDX-License-Identifier: MIT

description: Input processor for triggering a kscan signal or multiple behaviors based on position

compatible: "he,input-processor-adjustable-actuation"

include: ip_one_param.yaml

properties:
  sensitivity:
    description: Controls how big is the window from the press to the release point
    type: int
    required: true
  kscan-passthrough:
    description: Ignore the behaviors defined here and use the ones defined in zmk,keymap
    type: boolean
  kscan-passthrough-position:
    description: The position at which the passthrough will be triggered
    type: int
  kscan-forwarder:
    description: The kscan forwarder to use for this input processor
    type: phandle
  keymap-size:
    description: The number of keys that will use this input processor
    type: int
    required: true

child-binding:
  description: "A behavior to execute when the sensor reaches a certain position"

  properties:
    position:
      description: The position at which the behavior will be executed
      type: int
      required: true
    direction:
      description: The direction of the behavior
      type: string
      default: both
      enum:
        - up
        - down
        - both
    bindings:
      description: List of behaviors to execute when the sensor reaches a certain position
      type: phandle-array
      required: true
```

## dts/bindings/input_processors/he,input-processor-blank-he.yaml
```yaml
# Copyright (c) 2025, cr3eperall
# SPDX-License-Identifier: MIT

description: Input processor that blocks/does nothing to Hall effect inputs and can log a warning

compatible: "he,input-processor-blank-he"

include: ip_zero_param.yaml

properties:
  log:
    description: Logs when a Hall effect input is received
    type: boolean
  block:
    description: Stop propagating the input when a Hall effect input is received
    type: boolean
```

## dts/bindings/input_processors/he,input-processor-gamepad-forwarder.yaml
```yaml
# Copyright (c) 2025, cr3eperall
# SPDX-License-Identifier: MIT

description: Input processor for mapping an hall effect input to a mouse input

compatible: "he,input-processor-gamepad-forwarder"

include: ip_one_param.yaml


#TODO add custom curve mapping
properties:
  accumulation-time:
    description: The time in milliseconds to accumulate the xy inputs, a sync event will be sent when the time is up
    type: int
    default: 2
  time-to-max-speed-ms:
    description: The time in milliseconds to reach the max speed, it's an array with 1 to 4 values, 1 value= everytihng, 2 values= joystick and triggers, 4 values= joystick left, trigger left, joystick right, trigger right
    type: array
    required: true
  acceleration-exponent:
    type: int
    default: 1
  normalize-circle:
    description: Normalize the input to a circle instead of a square
    type: boolean
  working-area:
    description: The working area the input, if the signal is outside of this bound, it will not be propagated
    type: array
    default: 
      - 300
      - 2800
  scale-x-l-float:
    description: Scale the x axis of the left joystick
    type: int
    default: 0x40a00000 # 5.0
  scale-y-l-float:
    description: Scale the y axis of the left joystick
    type: int
    default: 0x40a00000 # 5.0
  scale-t-l-float:
    description: Scale the left trigger input
    type: int
    default: 0x40a00000 # 5.0
  scale-x-r-float:
    description: Scale the x axis of the right joystick
    type: int
    default: 0x40a00000 # 5.0
  scale-y-r-float:
    description: Scale the y axis of the right joystick
    type: int
    default: 0x40a00000 # 5.0
  scale-t-r-float:
    description: Scale the right trigger input
    type: int
    default: 0x40a00000 # 5.0
```

## dts/bindings/input_processors/he,input-processor-keymap.yaml
```yaml
# Copyright (c) 2025, cr3eperall
# SPDX-License-Identifier: MIT

description: Allows defining a keymap for Hall effect sensors composed of multiple layers

compatible: "he,input-processor-keymap"

include: ip_one_param.yaml

properties:
  transform:
    description: The matrix transform to use along with this layout
    type: phandle

child-binding:
  description: "A layer to be used in a keymap"

  properties:
    input-processors:
      description: List of input processors like bindings for zmk,keymap, one per Hall effect sensor
      type: phandle-array
      required: true
```

## dts/bindings/input_processors/he,input-processor-matrix-offset.yaml
```yaml
# Copyright (c) 2025, cr3eperall
# SPDX-License-Identifier: MIT

description: Input processor for adding an offset to the row and column of inputs received

compatible: "he,input-processor-matrix-offset"

include: ip_two_param.yaml
```

## dts/bindings/input_processors/he,input-processor-mouse-forwarder.yaml
```yaml
# Copyright (c) 2025, cr3eperall
# SPDX-License-Identifier: MIT

description: Input processor for mapping an hall effect input to a mouse input

compatible: "he,input-processor-mouse-forwarder"

include: ip_one_param.yaml

properties:
  accumulation-time:
    description: The time in milliseconds to accumulate the xy inputs, a sync event will be sent when the time is up
    type: int
    default: 2
  time-to-max-speed-ms:
    type: int
    required: true
  acceleration-exponent:
    type: int
    default: 1
  # max-accumulation-time:
  #   description: The maximum time in milliseconds to keep old xy inputs, if no events happen between the min and the max, the accumulated events will be discarded
  #   type: int
  #   default: 10
  working-area:
    description: The working area the input, if the signal is outside of this bound, it will not be propagated
    type: array
    default: 
      - 500
      - 2800
  scale-x-float:
    description: Scale the x axis of the mouse input
    type: int
    default: 0x40a00000 # 5.0
  scale-y-float:
    description: Scale the y axis of the mouse input
    type: int
    default: 0x40a00000 # 5.0
  scale-h-wheel-float:
    description: Scale the horizontal wheel axis of the mouse input
    type: int
    default: 0x40a00000 # 5.0
  scale-v-wheel-float:
    description: Scale the vertical wheel axis of the mouse input
    type: int
    default: 0x40a00000 # 5.0
```

## dts/bindings/input_processors/he,input-processor-rapid-trigger.yaml
```yaml
# Copyright (c) 2025, cr3eperall
# SPDX-License-Identifier: MIT

description: Input processor for triggering a kscan signal or behavior based on the direction of the key

compatible: "he,input-processor-rapid-trigger"

include: ip_one_param.yaml

properties:
  sensitivity:
    description: Controls how big is the window from the press to the release point
    type: int
    required: true
  kscan-passthrough:
    description: Ignore the behaviors defined here and use the ones defined in zmk,keymap
    type: boolean
  kscan-forwarder:
    description: The kscan forwarder to use for this input processor
    type: phandle
  keymap-size:
    description: The number of keys that will use this input processor
    type: int
    required: true
  actuation-point:
    description: When rapid trigger will be enabled
    type: int
    required: true
  bindings:
    description: List of behaviors to execute
    type: phandle-array
```
