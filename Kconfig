## dts/bindings/input_processors/he,input-processor-socd.yaml
```yaml
# Copyright (c) 2025, cr3eperall
# SPDX-License-Identifier: MIT

description: Input processor for Simultaneous Opposing Cardinal Directions (SOCD) 

compatible: "he,input-processor-socd"

include: ip_one_param.yaml

properties:
  sensitivity:
    description: Controls how big is the window from the press to the release point
    type: int
    required: true
  equal-sensitivity:
    description: Only works for priority_deeper, controls how big is the distance in which both keys will be pressed, \
                set to 0 to disable (only one key pressed at a time), minimum value when enabled is `sensitivity`
    type: int
    default: 0
  kscan-passthrough:
    description: Ignore the behaviors defined here and use the ones defined in zmk,keymap
    type: boolean
  kscan-forwarder:
    description: The kscan forwarder to use for this input processor
    type: phandle
  actuation-point:
    description: When socd will be enabled
    type: int
    required: true
  behaviors-first-n:
    description: the number of behaviors for the first key
    type: int
    default: 1
  bindings:
    description: List of behaviors to execute(first bindings-first-n behaviors will be used for the first key, the rest for the second key) 
    type: phandle-array
  type:
    description: The type of SOCD to use
    type: string
    default: priority_last
    enum:
      - priority_last # the last key to trigger will be the only one presed
      - priority_first # the first key to trigger will be the only one presed, the other will be ignored
      - priority_deeper # the key that is pressed the furthest will be the only one pressed, see `equal-sensitivity` for more configuration options
      - priority_direction # a combination of priority_last and rapid trigger
      - priority_0 # the first bound key will be the only one pressed, the other will be ignored
      - priority_1 # the second bound key will be the only one pressed, the other will be ignored
```

## dts/bindings/input_processors/he,raw-signal-processor.yaml
```yaml
# Copyright (c) 2025, cr3eperall
# SPDX-License-Identifier: MIT

description: Input processor for processing the raw hall effect sensor signal by limiting the output and filtering the noise

compatible: "he,raw-signal-processor"

include: ip_zero_param.yaml

properties:
  matrix-size:
    description: The size of the input matrix as rows x columns, if the data received is outside of the matrix it will not be processed
    type: array
    required: true
  offset:
    description: Offset of the matrix
    type: array
    default: 
      - 0
      - 0
  filter-coefficients:
    description: SOS coefficients for the filter as an array of floats represented as 32-bit hex integers
    type: array
  variable-sample-compensation:
    description: how many fake samples to add when the sample frequency is reduced (e.g. when the switch is idle)
    type: int
    default: 0
  wait-period-press:
    description: the time in milliseconds between samples when the switch is active (when the time between 2 samples is greater than 2 * wait-period-press it will be considered as idle)
    type: int
    default: 1
  working-area:
    description: The working area the sensor, if the signal is outside of this bound, it will not be propagated
    type: array
    default:
      - 150
      - 3150
  sample-div:
    description: lets an input for a key pass only once every `sample-div`*`wait-period-press` milliseconds, (this applies individually to every key position)
    type: int
    default: 1
```

## dts/bindings/sensor/zmk,battery-nrf-vddh-channel.yaml
```yaml
# Copyright (c) 2021 The ZMK Contributors
# SPDX-License-Identifier: MIT

description: Battery SoC monitoring using nRF VDDH

compatible: "zmk,battery-nrf-vddh-channel"

properties:
  io-channels:
    description: ADC channel the battery measurement
    type: phandle-array
    required: true
```

## dts/bindings/zmk,kscan-adc-direct.yaml
```yaml
# Copyright (c) 2020, Pete Johanson
# SPDX-License-Identifier: MIT

description: Analog key kscan controller

compatible: "zmk,kscan-adc-direct"

include: kscan.yaml

properties:
  resolution:
    type: int
    default: 12
    enum:
      - 8
      - 10
      - 12
  pulse-read:
    type: boolean
  read-turn-on-time:
    description: Time to wait before reading the key after turning it on
    type: int
    default: 100
  wait-period-idle:
    type: int
    default: 5
  wait-period-press:
    type: int
    default: 1

child-binding:
  description: Per enable-gpio group configuration
  properties:
    enable-gpios:
      type: phandle-array
    switch-pressed-is-higher: #TODO change to lower if needed
      type: boolean
    switch-height:
      description: Height of the switch in micrometers
      type: int
      default: 3300
      
  child-binding:
    description: Per key configuration
    properties:
      io-channels:
        description: ADC channel for this key
        type: phandle-array
        required: true
      press-point:
        type: int
        description: Threshold to consider a key as pressed in micrometers from the top
        default: 2500
      release-point:
        type: int
        description: Threshold to consider a key as released in micrometers from the top
        default: 3000
      calibration-min:
        type: int
        description: Minimum value to consider for calibration
        default: 0
      calibration-max:
        type: int
        description: Maximum value to consider for calibration
        default: 0
        
```

## dts/bindings/zmk,kscan-forwarder.yaml
```yaml
# Copyright (c) 2020, Pete Johanson
# SPDX-License-Identifier: MIT

description: Device that allows any device to generate kscan events by forwarding the event to the specified compatible driver.

compatible: "zmk,kscan-forwarder"

properties:
  kscan: 
    type: phandle
    description: The kscan device to forward events to.
    required: true
```

## dts/bindings/zmk,kscan-he-direct-pulse.yaml
```yaml
# Copyright (c) 2020, Pete Johanson
# SPDX-License-Identifier: MIT

description: Hall effect key kscan controller that produces analog inputs

compatible: "zmk,kscan-he-direct-pulse"

include: kscan.yaml

properties:
  resolution:
    type: int
    default: 12
    enum:
      - 8
      - 10
      - 12
  pulse-read:
    type: boolean
  read-turn-on-time:
    description: Time to wait before reading the key after turning it on
    type: int
    default: 100
  wait-period-idle:
    type: int
    default: 5
  wait-period-press:
    type: int
    default: 1
  kscan-forwarder:
    description: The kscan forwarder to bind this instance to.
    type: phandle

child-binding:
  description: Per enable-gpio group configuration
  properties:
    enable-gpios:
      type: phandle-array #TODO change to phandle
    switch-pressed-is-higher: #TODO change to lower if needed
      type: boolean
    switch-height:
      description: Height of the switch in micrometers
      type: int
      default: 3300
      
  child-binding:
    description: Per key configuration
    properties:
      io-channels:
        description: ADC channel for this key
        type: phandle-array
        required: true
      deadzone-top:
        type: int
        description: Threshold to start sending events in micrometers from the top
        default: 250
      deadzone-bottom:
        type: int
        description: Threshold to pause sending events in micrometers from the bottom
        default: 250
      calibration-min:
        type: int
        description: Minimum value to consider for calibration in raw ADC units
        default: 0
      calibration-max:
        type: int
        description: Maximum value to consider for calibration in raw ADC units
        default: 0
        
```

## dts/bindings/zmk,kscan-he-direct-pulsed.yaml
```yaml
# Copyright (c) 2025, cr3eperall
# SPDX-License-Identifier: MIT

description: Hall effect kscan controller that produces INPUT_HE_RC analog inputs in micrometers of height

compatible: "zmk,kscan-he-direct-pulsed"

include: kscan.yaml

properties:
  resolution:
    type: int
    default: 12
    enum:
      - 8
      - 10
      - 12
  pulse-read:
    type: boolean
  read-turn-on-time:
    description: Time to wait before reading the key after turning it on
    type: int
    default: 100
  wait-period-idle:
    type: int
    default: 5
  wait-period-press:
    type: int
    default: 1
  kscan-forwarder:
    description: kscan-forwarder to pass the kscan callback to
    type: phandle
  calibrate:
    description: Print the raw values to serial and don't send them to the input listener
    type: boolean
  polyfit:
    description: Polynomial fit coefficients as an array of floats represented as 32-bit hex integers(first coefficient is the highest degree coefficient, last is the constant term)
    type: array
    default: #coefficients calculated for Gateron low profile magnetic jade pro
      - 0x408b2298
      - 0xc1167de4
      - 0x40fed831
      - 0xc02b2742
      - 0x3f404977
      - 0x3bd693e5

child-binding:
  description: Per enable-gpio group configuration
  properties:
    enable-gpios:
      type: phandle-array
    switch-pressed-is-higher: #TODO change to lower if needed
      type: boolean
    switch-height:
      description: Height of the switch in micrometers
      type: int
      default: 3300
      
  child-binding:
    description: Per key configuration
    properties:
      io-channels:
        description: ADC channel for this key
        type: phandle-array
        required: true
      deadzone-top:
        type: int
        description: Threshold to start producing events in micrometers from the top
        default: 250
      deadzone-bottom:
        type: int
        description: Threshold to pause producing events in micrometers from the bottom
        default: 250
      calibration-min:
        type: int
        description: Minimum value to consider for calibration
        default: 0
      calibration-max:
        type: int
        description: Maximum value to consider for calibration
        default: 0
        
```
