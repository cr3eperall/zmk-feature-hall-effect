## src/behaviors/Kconfig
```kconfig
config HE_BEHAVIOR_GAMEPAD_BTN
    bool "Enable gamepad button behavior"
    default y
    depends on DT_HAS_HE_BEHAVIOR_GAMEPAD_BTN_ENABLED

config HE_BEHAVIOR_PULSE_SET
    bool "Enable pulse set behavior"
    default y
    depends on DT_HAS_HE_BEHAVIOR_PULSE_SET_ENABLED
```

## src/hid/Kconfig
```kconfig
config HE_GAMEPAD_HID
    bool "Enable gamepad HID report"
    default n

config HE_GAMEPAD_HID_SWAP_TRIGGER_R_AXIS
    bool "Swap trigger and Right axis"
    default n
    depends on HE_GAMEPAD_HID

config HE_GAMEPAD_HID_NUM_BUTTONS
    int "Number of buttons in the hid report"
    default 8
    range 1 32
    depends on HE_GAMEPAD_HID


if HE_GAMEPAD_HID


config USB_HID_DEVICE_COUNT
    default 2

endif
```

## src/input_processors/Kconfig
```kconfig
config HE_INPUT_PROCESSOR_ADJUSTABLE_ACTUATION
    bool "Enable adjustable actuation input processor"
    default y
    depends on DT_HAS_HE_INPUT_PROCESSOR_ADJUSTABLE_ACTUATION_ENABLED

config HE_INPUT_PROCESSOR_BLANK_HE
    bool "Enable blank input processor"
    default y
    depends on DT_HAS_HE_INPUT_PROCESSOR_BLANK_HE_ENABLED

config HE_INPUT_PROCESSOR_GAMEPAD_FORWARDER
    bool "Enable gamepad forwarder input processor"
    default y
    depends on DT_HAS_HE_INPUT_PROCESSOR_GAMEPAD_FORWARDER_ENABLED
    select HE_GAMEPAD_HID

config HE_INPUT_PROCESSOR_KEYMAP
    bool "Enable keymap input processor"
    default y
    depends on DT_HAS_HE_INPUT_PROCESSOR_KEYMAP_ENABLED

config HE_INPUT_PROCESSOR_MATRIX_OFFSET
    bool "Enable matrix offset input processor"
    default y
    depends on DT_HAS_HE_INPUT_PROCESSOR_MATRIX_OFFSET_ENABLED

config HE_INPUT_PROCESSOR_MOUSE_FORWARDER
    bool "Enable mouse forwarder input processor"
    default y
    depends on DT_HAS_HE_INPUT_PROCESSOR_MOUSE_FORWARDER_ENABLED

config HE_INPUT_PROCESSOR_RAPID_TRIGGER
    bool "Enable rapid trigger input processor"
    default y
    depends on DT_HAS_HE_INPUT_PROCESSOR_RAPID_TRIGGER_ENABLED

config HE_INPUT_PROCESSOR_SOCD
    bool "Enable SOCD input processor"
    default y
    depends on DT_HAS_HE_INPUT_PROCESSOR_SOCD_ENABLED

config HE_RAW_SIGNAL_PROCESSOR
    bool "Enable raw signal processor"
    default y
    depends on DT_HAS_HE_RAW_SIGNAL_PROCESSOR_ENABLED
```

## src/kscan/Kconfig
```kconfig
config HE_KSCAN_DIRECT_PULSED
    bool "Enable HE KSCAN direct pulsed"
    default y
    depends on DT_HAS_HE_KSCAN_DIRECT_PULSED_ENABLED
    select ADC
    select KSCAN

rsource "forwarders/Kconfig"
```

## src/kscan/forwarders/Kconfig
```kconfig
config HE_KSCAN_FORWARDER
    bool "Enable HE KSCAN forwarder"
    default y
    depends on DT_HAS_HE_KSCAN_FORWARDER_ENABLED
```

## src/sensor/Kconfig
```kconfig
# Copyright (c) 2020-2021 The ZMK Contributors
# SPDX-License-Identifier: MIT

config ZMK_BATTERY
    bool "ZMK battery monitoring"
    help
        Enable battery monitoring

config ZMK_BATTERY_NRF_VDDH_CHANNEL
    bool
    default y
    select ADC
    select ZMK_BATTERY
    depends on SENSOR
    depends on DT_HAS_ZMK_BATTERY_NRF_VDDH_CHANNEL_ENABLED
    depends on !ZMK_BATTERY_NRF_VDDH
    help
        Enable ZMK nRF VDDH voltage driver for battery monitoring with selectable adc channel.
```
